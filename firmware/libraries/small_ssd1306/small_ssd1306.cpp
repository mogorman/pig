#include <avr/pgmspace.h>
#include <util/delay.h>
#include <stdlib.h>

#include "small_ssd1306.h"

static uint8_t buffer[SSD1306_LCDHEIGHT * SSD1306_LCDWIDTH / 8] = {//start up screen
0x7F, 0x7F, 0x7F, 0x3F, 0x3F, 0x1F, 0x1E, 0x3E, 0x40, 0x80, 0x01, 0x01, 0x1E, 0xA1, 0x41, 0x27,
0x3F, 0x3F, 0x3F, 0xFF, 0x7F, 0x7F, 0x7F, 0x7E, 0xFC, 0xF1, 0xE6, 0xC8, 0x10, 0x60, 0x80, 0x00,
0x00, 0x00, 0x00, 0x00, 0x00, 0xC0, 0x1F, 0xC0, 0xFF, 0xFF, 0xDF, 0x00, 0x00, 0x00, 0xFF, 0x00,
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0x00, 0x03, 0x1F, 0x3F, 0x1F, 0x1F, 0x3F, 0x7F, 0x7F, 0x7F, 0x3C, 0x18, 0x00, 0x00, 0x00, 0x00
};

static const unsigned char PROGMEM terminus [] = { //13x20 terminus font
  0xFC, 0x07, 0x1C, 0xF0, 0x1F, 0xFE, 0x03, 0xC0, 0xFF, 0x3F, 0xFF, 0xFB,
  0xFF, 0xFC, 0x87, 0xFF, 0x00, 0xFE, 0x0F, 0x1E, 0xF8, 0x3F, 0xFF, 0x07,
  0xE0, 0xFF, 0xBF, 0xFF, 0xFB, 0xFF, 0xFE, 0xCF, 0xFF, 0x01, 0x0F, 0x1E,
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  0xFC, 0xC7, 0xFF, 0x00
};

static const unsigned char PROGMEM terminus_font [] = { //10x15 terminus font
   0x30, 0x30, 0xc3, 0x0c, 0x0c, 0x00, 0xe0, 0x00, 0x03, 0x18, 0x18, 0x00,
   0x00, 0x00, 0x00, 0x00, 0x00, 0x00, 0x00, 0x3f, 0x30, 0xf0, 0xc3, 0x0f,
   0xc0, 0xff, 0xf3, 0xf7, 0x3f, 0x3f, 0xfc, 0x00, 0x00, 0x00, 0x60, 0x00,
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   0x0f, 0x1c, 0x0c, 0x1c, 0x00, 0x00
};

small_ssd1306::small_ssd1306(int8_t MOSI, int8_t CLOCK, int8_t DC, int8_t RESET,
			     int8_t CS, int8_t POWER, int8_t INVERT_SCREEN, int8_t ORIENTATION){
  mosi = MOSI;
  clock = CLOCK;
  dc = DC;
  reset = RESET;
  cs = CS;
  power = POWER;
  invert_screen = INVERT_SCREEN;
  orientation = ORIENTATION;
  cursor_x = 0;
  cursor_y = 0;
  font_size = 0;
  pinMode(dc, OUTPUT);
  pinMode(cs, OUTPUT);
  pinMode(mosi, OUTPUT);
  pinMode(clock, OUTPUT);
  pinMode(power, OUTPUT);


}

void small_ssd1306::on(void) {

  pinMode(mosi, OUTPUT);
  pinMode(dc, OUTPUT);
  pinMode(cs, OUTPUT);
  pinMode(clock, OUTPUT);
  pinMode(reset, OUTPUT);
 
  digitalWrite(power, LOW); // turn oled on
  delay(20);
  // Setup reset pin direction (used by both SPI and I2C)  
  digitalWrite(reset, HIGH);
  // VDD (3.3V) goes high at start, lets just chill for a ms
  delay(1);
  // bring reset low
  digitalWrite(reset, LOW);
  // wait 10ms
  delay(10);
  // bring out of reset
  digitalWrite(reset, HIGH);
  // turn on VCC (9V?)
    // Init sequence for 128x32 OLED module
  spi_write(SSD1306_DISPLAYOFF);                    // 0xAE
  spi_write(SSD1306_SETDISPLAYCLOCKDIV);            // 0xD5
  spi_write(0x80);                                  // the suggested ratio 0x80
  spi_write(SSD1306_SETMULTIPLEX);                  // 0xA8
  spi_write(0x1F);
  spi_write(SSD1306_SETDISPLAYOFFSET);              // 0xD3
  spi_write(0x0);                                   // no offset
  spi_write(SSD1306_SETSTARTLINE | 0x0);            // line #0
  spi_write(SSD1306_CHARGEPUMP);                    // 0x8D
  spi_write(0x14); //switchcap
  spi_write(SSD1306_MEMORYMODE);                    // 0x20
  spi_write(0x00);                                  // 0x0 act like ks0108
  spi_write(SSD1306_SEGREMAP | 0x1);
  spi_write(SSD1306_COMSCANDEC);
  spi_write(SSD1306_SETCOMPINS);                    // 0xDA
  spi_write(0x02);
  spi_write(SSD1306_SETCONTRAST);                   // 0x81
  spi_write(0xCF);
  spi_write(SSD1306_SETPRECHARGE);                  // 0xd9
  spi_write(0xF1); //switch cap
  spi_write(SSD1306_SETVCOMDETECT);                 // 0xDB
  spi_write(0x40);
  spi_write(SSD1306_DISPLAYALLON_RESUME);           // 0xA4
  if(invert_screen) {
    spi_write(SSD1306_INVERTDISPLAY);
  } else {
    spi_write(SSD1306_NORMALDISPLAY);
  }
  if(orientation) {
    spi_write(SSD1306_SEGREMAP);
    spi_write(SSD1306_COMSCANINC);
  }
  spi_write(SSD1306_DISPLAYON); //--turn on oled panel

  //yuck?
}
void small_ssd1306::off(void) {
  spi_write(SSD1306_DISPLAYOFF);	// put the OLED display in sleep mode
  spi_write(0x8D);  // disable charge pump
  spi_write(0x10);  // disable charge pump

  delay(10);
  digitalWrite(power, HIGH);

  pinMode(mosi, INPUT);
  pinMode(dc, INPUT);
  pinMode(cs, INPUT);
  pinMode(clock, INPUT);
  pinMode(reset, INPUT);

  digitalWrite(reset, LOW);
  digitalWrite(mosi, LOW);
  digitalWrite(dc, LOW);
  digitalWrite(cs, LOW);
  digitalWrite(clock, LOW);
}

void small_ssd1306::invert(void) {
  if(invert_screen) {
    invert_screen=0;
    spi_write(SSD1306_NORMALDISPLAY);
  } else {
    invert_screen=1;
    spi_write(SSD1306_INVERTDISPLAY);
  }
}

void small_ssd1306::set_font(int8_t value) {
  font_size=value;
}

void small_ssd1306::clear(void) {
  memset(buffer, 0, (SSD1306_LCDWIDTH*SSD1306_LCDHEIGHT/8));
}

void small_ssd1306::set_pixel(uint8_t x, uint8_t y, uint8_t on) {
  if ((x < 0) || (x >= SSD1306_LCDWIDTH) || (y < 0) || (y >= SSD1306_LCDHEIGHT))
    return;
  // x is which column
  if (on) 
    buffer[x+ (y/8)*SSD1306_LCDWIDTH] |= (1 << (y&7));  
  else
    buffer[x+ (y/8)*SSD1306_LCDWIDTH] &= ~(1 << (y&7)); 
}

void small_ssd1306::draw_bitmap(uint8_t x, uint8_t y, const uint8_t *bitmap,
				uint16_t w, uint16_t h, uint16_t w2, uint16_t h2,
				uint16_t w_size, uint16_t h_size, uint8_t on) {
  int16_t i, j, byteWidth = (w_size + 7) / 8;

  for(j=h; j<h_size; j++) {
    if(j >= h2) {
      break;
    }
    for(i=w; i<w_size; i++ ) {
      if( i >= w2) {
	break;
      }
      if(pgm_read_byte(bitmap + j * byteWidth + i / 8) & (1 << (i % 8))) {
	  set_pixel(x+i-w, y+j-h, on);
      }
    }
  }
}

size_t small_ssd1306::write(uint8_t c) {
  uint16_t character;
  if(font_size == 1) {
    if(c >= 0x30 && c < 0x40) {
      character = (c - 0x30)*13;
      draw_bitmap(cursor_x, cursor_y, terminus, character, 0, character+13, 20, 136, 20, 1);
      cursor_x+=17;
      return 1;
    }
  } 
  if (c == '\n') {
    cursor_y += 16;
    cursor_x  = 0;
  } else if (c == ' ') {
    cursor_x  += 11;
  } else if (c >= 0x21 && ( c <= 0x7E)) {
    character = (c-0x21)*10;
      draw_bitmap(cursor_x, cursor_y, terminus_font, character, 0, character+10, 15, 944, 15, 1);
      cursor_x+=11;

    if ((cursor_x > (SSD1306_LCDWIDTH - 11))) {
      cursor_y += 16;
      cursor_x = 0;
    }
  }
return 1;

}

void small_ssd1306::set_cursor(int8_t x, int8_t y) {
  cursor_x = x;
  cursor_y = y;
}

void small_ssd1306::update(void) {
  spi_write(SSD1306_COLUMNADDR);
  spi_write(0);   // Column start address (0 = reset)
  spi_write(127); // Column end address (127 = reset)

  spi_write(SSD1306_PAGEADDR);
  spi_write(0); // Page start address (0 = reset)
  spi_write(3); // Page end address

  for (uint16_t i=0; i<(SSD1306_LCDWIDTH*SSD1306_LCDHEIGHT/8); i++) {
    digitalWrite(dc, HIGH);
    digitalWrite(cs, LOW);
    shiftOut(mosi, clock, MSBFIRST, buffer[i]);
    digitalWrite(cs, HIGH);
  }


}

void small_ssd1306::spi_write(uint8_t data) {
  digitalWrite(dc, LOW);
  digitalWrite(cs, LOW);
  shiftOut(mosi, clock, MSBFIRST, data);
  digitalWrite(cs, HIGH);
}
